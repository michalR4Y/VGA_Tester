/* USER CODE BEGIN Header */
/**
 ******************************************************************************
 * @file           : main.c
 * @brief          : Main program body
 ******************************************************************************
 * @attention
 *
 * Copyright (c) 2026 STMicroelectronics.
 * All rights reserved.
 *
 * This software is licensed under terms that can be found in the LICENSE file
 * in the root directory of this software component.
 * If no LICENSE file comes with this software, it is provided AS-IS.
 *
 ******************************************************************************
 */
/* USER CODE END Header */
/* Includes ------------------------------------------------------------------*/
#include "main.h"
#include "dma.h"
#include "spi.h"
#include "tim.h"
#include "gpio.h"

/* Private includes ----------------------------------------------------------*/
/* USER CODE BEGIN Includes */
#include <string.h>
#include <stdint.h>

/* USER CODE END Includes */

/* Private typedef -----------------------------------------------------------*/
/* USER CODE BEGIN PTD */

/* USER CODE END PTD */

/* Private define ------------------------------------------------------------*/
/* USER CODE BEGIN PD */
#define VGA_WIDTH  640
#define VGA_HEIGHT 480
#define LINE_BYTES (VGA_WIDTH / 8) // 80 bajtów na linię

/* USER CODE END PD */

/* Private macro -------------------------------------------------------------*/
/* USER CODE BEGIN PM */

/* USER CODE END PM */

/* Private variables ---------------------------------------------------------*/

/* USER CODE BEGIN PV */
// Bufor ramki w RAM (38.4 KB)
uint8_t frame_buffer[VGA_HEIGHT * LINE_BYTES];
volatile uint16_t v_line_counter = 0;

/* Prosta czcionka 8x8 (Przykładowe znaki ASCII 32-90) -----------------*/
//const uint8_t font8x8[][8] =
//  {[0x20 - 0x20] =
//  { 0x00, 0x00, 0x00, 0x00, 0x00, 0x00, 0x00, 0x00}, // Spacja
//  ['A' - 0x20] =
//  { 0x18, 0x3C, 0x66, 0x7E, 0x66, 0x66, 0x66, 0x00}, ['B' - 0x20] =
//  { 0x7C, 0x66, 0x66, 0x7C, 0x66, 0x66, 0x7C, 0x00}, ['C' - 0x20] =
//  { 0x3C, 0x66, 0x06, 0x06, 0x06, 0x66, 0x3C, 0x00}, ['M' - 0x20] =
//  { 0x66, 0x7E, 0x7E, 0x66, 0x66, 0x66, 0x66, 0x00}, ['O' - 0x20] =
//  { 0x3C, 0x66, 0x66, 0x66, 0x66, 0x66, 0x3C, 0x00}, ['S' - 0x20] =
//  { 0x3E, 0x06, 0x06, 0x3C, 0x60, 0x60, 0x7C, 0x00}, ['T' - 0x20] =
//  { 0x7E, 0x18, 0x18, 0x18, 0x18, 0x18, 0x18, 0x00}, ['V' - 0x20] =
//  { 0x66, 0x66, 0x66, 0x66, 0x66, 0x3C, 0x18, 0x00}, ['G' - 0x20] =
//  { 0x3C, 0x66, 0x06, 0x3E, 0x66, 0x66, 0x3C, 0x00}, ['3' - 0x20] =
//  { 0x3C, 0x06, 0x06, 0x1C, 0x06, 0x06, 0x3C, 0x00}, ['2' - 0x20] =
//  { 0x3C, 0x06, 0x06, 0x3C, 0x60, 0x60, 0x7E, 0x00}, ['K' - 0x20] =
//    {0x66, 0x6C, 0x78, 0x70, 0x78, 0x6C, 0x66, 0x00}};

/* Pełna tablica znaków ASCII 8x8 (od 0x20 do 0x7E) */
const uint8_t font8x8[95][8] = {
    {0x00,0x00,0x00,0x00,0x00,0x00,0x00,0x00}, // spacja (0x20)
    {0x18,0x3C,0x3C,0x18,0x18,0x00,0x18,0x00}, // !
    {0x66,0x66,0x66,0x00,0x00,0x00,0x00,0x00}, // "
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    {0x31,0x6B,0x46,0x00,0x00,0x00,0x00,0x00}  // ~
};
/* USER CODE END PV */

/* Private function prototypes -----------------------------------------------*/
void SystemClock_Config(void);
/* USER CODE BEGIN PFP */

/* USER CODE END PFP */

/* Private user code ---------------------------------------------------------*/
/* USER CODE BEGIN 0 */
/* Funkcje graficzne ---------------------------------------------------*/

// Funkcja rysująca piksel (x: 0-639, y: 0-479)
void VGA_DrawPixel(int16_t x, int16_t y, uint8_t color)
{
  if(x < 0 || x >= VGA_WIDTH || y < 0 || y >= VGA_HEIGHT)
  {
    return;
  }
  if(color)
  {
    frame_buffer[y * LINE_BYTES + (x / 8)] |= (0x80 >> (x % 8));
  }
  else
  {
    frame_buffer[y * LINE_BYTES + (x / 8)] &= ~(0x80 >> (x % 8));
  }
}

// Funkcja czyszcząca ekran
void VGA_Clear(uint8_t color)
{
  memset(frame_buffer, 0x00, sizeof(frame_buffer));
}

void VGA_DrawChar(int16_t x, int16_t y, char c, uint8_t color)
{
  if(c < 32 || c > 126)
    c = ' ';
  const uint8_t *glyph = font8x8[c - 0x20];
  for(int i = 0; i < 8; i++)
  {
    for(int j = 0; j < 8; j++)
    {
      if(glyph[i] & (0x80 >> j))
      {
        VGA_DrawPixel(x + j, y + i, color);
      }
    }
  }
}

void VGA_PrintString(int16_t x, int16_t y, char *str, uint8_t color)
{
  while(*str)
  {
    VGA_DrawChar(x, y, *str++, color);
    x += 8;
    if(x + 8 >= VGA_WIDTH)
    {
      x = 0;
      y += 8;
    }
  }
}

/**
 * @brief Przerwanie Timera 1 - wywoływane co 31.7us (co linię H-Sync)
 */
void HAL_TIM_PeriodElapsedCallback(TIM_HandleTypeDef *htim)
{
  if(htim->Instance == TIM1)
  {
    // VGA Active Video: Linie od ok. 35 do 515 (uwzględniając Back Porch)
    if(v_line_counter >= 35 && v_line_counter < 480 + 35)
    {
      uint16_t current_display_line = v_line_counter - 35;

      // Start transferu DMA dla jednej linii (80 bajtów)
      // Używamy niskopoziomowego rejestru dla szybkości
      HAL_SPI_Transmit_DMA(&hspi2, &frame_buffer[current_display_line * LINE_BYTES], LINE_BYTES);
    }

    v_line_counter++;
    if(v_line_counter >= 525)
    {
      v_line_counter = 0;
    }
  }
}

void VGA_Init()
{
  // Start sygnałów synchronizacji
  HAL_TIM_PWM_Start(&htim1, TIM_CHANNEL_1); // H-Sync
  HAL_TIM_PWM_Start(&htim2, TIM_CHANNEL_2); // V-Sync

  // Włączenie przerwania TIM1, aby wiedzieć, kiedy zacząć wysyłać linię danych
  HAL_TIM_Base_Start_IT(&htim1);
}
/* USER CODE END 0 */

/**
 * @brief  The application entry point.
 * @retval int
 */
int main(void)
{

  /* USER CODE BEGIN 1 */

  /* USER CODE END 1 */

  /* MCU Configuration--------------------------------------------------------*/

  /* Reset of all peripherals, Initializes the Flash interface and the Systick. */
  HAL_Init();

  /* USER CODE BEGIN Init */

  /* USER CODE END Init */

  /* Configure the system clock */
  SystemClock_Config();

  /* USER CODE BEGIN SysInit */

  /* USER CODE END SysInit */

  /* Initialize all configured peripherals */
  MX_GPIO_Init();
  MX_DMA_Init();
  MX_SPI2_Init();
  MX_TIM1_Init();
  MX_TIM2_Init();
  /* USER CODE BEGIN 2 */
  VGA_Clear(0);

  // Rysowanie ramki testowej
//  for(int i = 0; i < VGA_HEIGHT; i++)
//  {
//    VGA_DrawPixel(50, i, 1);
//    VGA_DrawPixel(151, i, 1);
//    VGA_DrawPixel(200, i, 1);
//    VGA_DrawPixel(250, i, 1);
//    VGA_DrawPixel(300, i, 1);
//    VGA_DrawPixel(350, i, 1);
////    VGA_DrawPixel(i, VGA_HEIGHT - 1, 1);
//  }
//  for(int i = 0; i < VGA_HEIGHT; i++)
//  {
//    VGA_DrawPixel(i, i, 1);
//  }

  memset(frame_buffer, 0, VGA_HEIGHT * LINE_BYTES);

  // Tekst testowy
  VGA_PrintString(0, 10, "STM32 VGA OK", 1);
  VGA_PrintString(0, 20, "640X480 MONO", 1);

  // Wypełnienie bufora testowym wzorem (paski)
//  for(int y=0; y<480; y++)
//  {
//    for(int x=0; x<640; x++)
//    {
//      VGA_DrawPixel(x, y, (x ^ y) & 0x08);
//    }
//  }
  // Start Timerów
  VGA_Init();

  /* USER CODE END 2 */

  /* Infinite loop */
  /* USER CODE BEGIN WHILE */
  while(1)
  {
    /* USER CODE END WHILE */

    /* USER CODE BEGIN 3 */
    HAL_GPIO_TogglePin(LED1_GPIO_Port, LED1_Pin);
    HAL_Delay(250);
  }
  /* USER CODE END 3 */
}

/**
 * @brief System Clock Configuration
 * @retval None
 */
void SystemClock_Config(void)
{
  RCC_OscInitTypeDef RCC_OscInitStruct =
    {0};
  RCC_ClkInitTypeDef RCC_ClkInitStruct =
    {0};

  /** Configure the main internal regulator output voltage
   */
  if(HAL_PWREx_ControlVoltageScaling(PWR_REGULATOR_VOLTAGE_SCALE1) != HAL_OK)
  {
    Error_Handler();
  }

  /** Initializes the RCC Oscillators according to the specified parameters
   * in the RCC_OscInitTypeDef structure.
   */
  RCC_OscInitStruct.OscillatorType = RCC_OSCILLATORTYPE_HSE;
  RCC_OscInitStruct.HSEState = RCC_HSE_ON;
  RCC_OscInitStruct.PLL.PLLState = RCC_PLL_ON;
  RCC_OscInitStruct.PLL.PLLSource = RCC_PLLSOURCE_HSE;
  RCC_OscInitStruct.PLL.PLLM = 1;
  RCC_OscInitStruct.PLL.PLLN = 10;
  RCC_OscInitStruct.PLL.PLLP = RCC_PLLP_DIV7;
  RCC_OscInitStruct.PLL.PLLQ = RCC_PLLQ_DIV2;
  RCC_OscInitStruct.PLL.PLLR = RCC_PLLR_DIV2;
  if(HAL_RCC_OscConfig(&RCC_OscInitStruct) != HAL_OK)
  {
    Error_Handler();
  }

  /** Initializes the CPU, AHB and APB buses clocks
   */
  RCC_ClkInitStruct.ClockType = RCC_CLOCKTYPE_HCLK | RCC_CLOCKTYPE_SYSCLK | RCC_CLOCKTYPE_PCLK1 | RCC_CLOCKTYPE_PCLK2;
  RCC_ClkInitStruct.SYSCLKSource = RCC_SYSCLKSOURCE_PLLCLK;
  RCC_ClkInitStruct.AHBCLKDivider = RCC_SYSCLK_DIV1;
  RCC_ClkInitStruct.APB1CLKDivider = RCC_HCLK_DIV1;
  RCC_ClkInitStruct.APB2CLKDivider = RCC_HCLK_DIV1;

  if(HAL_RCC_ClockConfig(&RCC_ClkInitStruct, FLASH_LATENCY_4) != HAL_OK)
  {
    Error_Handler();
  }
}

/* USER CODE BEGIN 4 */

/* USER CODE END 4 */

/**
 * @brief  This function is executed in case of error occurrence.
 * @retval None
 */
void Error_Handler(void)
{
  /* USER CODE BEGIN Error_Handler_Debug */
  /* User can add his own implementation to report the HAL error return state */
  __disable_irq();
  while(1)
  {
  }
  /* USER CODE END Error_Handler_Debug */
}
#ifdef USE_FULL_ASSERT
/**
 * @brief  Reports the name of the source file and the source line number
 *         where the assert_param error has occurred.
 * @param  file: pointer to the source file name
 * @param  line: assert_param error line source number
 * @retval None
 */
void assert_failed(uint8_t *file, uint32_t line)
{
  /* USER CODE BEGIN 6 */
  /* User can add his own implementation to report the file name and line number,
   ex: printf("Wrong parameters value: file %s on line %d\r\n", file, line) */
  /* USER CODE END 6 */
}
#endif /* USE_FULL_ASSERT */
